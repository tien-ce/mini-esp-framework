#include "services/web/web_template.h"
#include "core/pin_config.h"
#include "core/core_log.h"
#include <ArduinoJson.h>
#include <freertos/semphr.h>
#include <string.h>

/* -------------------------------------------------------------------------- */
/*                              STATIC VARIABLES                              */
/* -------------------------------------------------------------------------- */

/*
 * Telemetry table for HTTP polling. A key keeps its last value until it has not been updated for
 * TELEMETRY_MAX_AGE polls, so a poll where a script handler missed its window does not drop the row.
 */
#define TELEMETRY_MAX_KEYS   30   /* Rows the table can hold */
#define TELEMETRY_KEY_LEN    30   /* Key buffer size, including the terminator */
#define TELEMETRY_VALUE_LEN  32   /* Value buffer size, including the terminator */
#define TELEMETRY_MAX_AGE    3    /* Polls in a row a key may go without an update before it is removed */

typedef struct {
    char     key[TELEMETRY_KEY_LEN];      /* key[0] == '\0' marks a free slot */
    char     value[TELEMETRY_VALUE_LEN];
    uint32_t last_poll;                   /* s_poll_count when the key was last written */
} telemetry_entry_t;

static telemetry_entry_t s_telemetry[TELEMETRY_MAX_KEYS];
static uint32_t s_poll_count = 0;

/** @brief Returns the mutex guarding the telemetry table (written by driver/script tasks, read by the web task). */
static SemaphoreHandle_t telemetryMutex() {
    static SemaphoreHandle_t m = xSemaphoreCreateMutex();
    return m;
}

/*
 * --------------------------------------------------------------------------
 * JSON Payload Schema generated by web_build_gpio_json()
 * --------------------------------------------------------------------------
 *
 * Root: JsonObject {}
 * │
 * ├── "options" : JsonArray [string, ...]
 * │     Shared list of all selectable pin functions (sent once for all pins).
 * │     Example: ["None", "Relay1", "Relay2", "Input1", "RS485_TX"]
 * │
 * └── "pins"    : JsonArray [JsonObject {}, ...]
 *       List of physical board pin configurations.
 *       Each item contains:
 *       ├── "gpio"  : (int)     GPIO pin number (e.g., 0, 6, 17)
 *       ├── "label" : (string)  Display text for the pin (e.g., "GPIO6")
 *       ├── "fixed" : (bool)   true: Hardware-fixed pin (disabled in UI)
 *       │                      false: Configurable pin (enabled dropdown)
 *       └── "value" : (string)  Active assigned function name
 *
 * --------------------------------------------------------------------------
 * Output Example:
 * --------------------------------------------------------------------------
 * {
 *   "options": ["None", "Relay1", "Relay2", "Input1"],
 *   "pins": [
 *     {"gpio": 6, "label": "GPIO6", "fixed": false, "value": "Relay1"},
 *     {"gpio": 9, "label": "GPIO9", "fixed": true,  "value": "SPI Flash"}
 *   ]
 * }
 * --------------------------------------------------------------------------
     */
void web_build_gpio_json(Print &out) {
    // Build a small document: shared option list once, then one entry per board pin
    JsonDocument doc;

    // Option names are shared by every selectable pin
    JsonArray options = doc["options"].to<JsonArray>();
    for (size_t i = 0; i < AVAILABLE_PIN_OPTIONS_COUNT; i++) {
        options.add(AVAILABLE_PIN_OPTIONS[i]);
    }

    // One entry per physical pin: current selection falls back to the board default
    JsonArray pins = doc["pins"].to<JsonArray>();
    for (size_t i = 0; i < BOARD_PIN_COUNT; i++) {
        const auto &pin = BOARD_PINS[i];
        String active = get_pin_name(pin.gpio);
        JsonObject o = pins.add<JsonObject>();
        o["gpio"] = pin.gpio;
        o["label"] = pin.label;
        o["fixed"] = pin.isFixed;
        o["value"] = (active.length() > 0 && !pin.isFixed) ? active.c_str() : pin.defaultOption;
    }

    // Stream straight to the caller (response stream), no intermediate String
    serializeJson(doc, out);
}

/* This function called from drives and scripts to update these value into the web */
void updateElementValue(const String& key, const String& newValue) {
    if (key.length() == 0) return;

    xSemaphoreTake(telemetryMutex(), portMAX_DELAY);
    telemetry_entry_t *slot = NULL;
    for (int i = 0; i < TELEMETRY_MAX_KEYS; i++) {
        if (strcmp(s_telemetry[i].key, key.c_str()) == 0) {
            slot = &s_telemetry[i];
            break;
        }
        if (slot == NULL && s_telemetry[i].key[0] == '\0') {
            slot = &s_telemetry[i];
        }
    }
    if (slot != NULL) {
        /* A key found by name is reused; otherwise slot is the first free entry */
        strlcpy(slot->key, key.c_str(), sizeof(slot->key));
        strlcpy(slot->value, newValue.c_str(), sizeof(slot->value));
        slot->last_poll = s_poll_count;
    }
    xSemaphoreGive(telemetryMutex());

    if (slot == NULL) {
        LOG_WARNING("[Web] Telemetry table is full, '" + key + "' dropped");
    }
}

/* Append s as a quoted JSON string, escaping quotes, backslashes and control characters */
static void json_append_string(String &out, const char *s) {
    out += '"';
    for (; *s; s++) {
        unsigned char c = (unsigned char)*s;
        if (c == '"' || c == '\\') {
            out += '\\';
            out += (char)c;
        } else if (c < 0x20) {
            char buf[7];
            snprintf(buf, sizeof(buf), "\\u%04x", c);
            out += buf;
        } else {
            out += (char)c;
        }
    }
    out += '"';
}

/* Called at the start of each poll: ages are counted in polls */
void web_begin_telemetry_poll() {
    xSemaphoreTake(telemetryMutex(), portMAX_DELAY);
    s_poll_count++;
    xSemaphoreGive(telemetryMutex());
}

/* This function is called after all module done with SIG_WEB_POLL signal, it will check what is key is deprecated to remove by set key = '\0'*/
String web_get_telemetry_json() {
    String json;
    json.reserve(256);
    json += '{';

    xSemaphoreTake(telemetryMutex(), portMAX_DELAY);
    bool first = true;
    for (int i = 0; i < TELEMETRY_MAX_KEYS; i++) {
        if (s_telemetry[i].key[0] == '\0') continue;

        /* Drop keys nobody has refreshed for too long (e.g. the script that owned them stopped) */
        if (s_poll_count - s_telemetry[i].last_poll > TELEMETRY_MAX_AGE) {
            s_telemetry[i].key[0] = '\0';
            continue;
        }
        if (!first) json += ',';
        first = false;
        json_append_string(json, s_telemetry[i].key);
        json += ':';
        json_append_string(json, s_telemetry[i].value);
    }
    xSemaphoreGive(telemetryMutex());

    json += '}';
    return json;
}
